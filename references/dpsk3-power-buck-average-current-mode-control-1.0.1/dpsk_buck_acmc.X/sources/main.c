/*
 * File:   main.c
 * Author: M91406
 *
 * Created on July 8, 2019, 1:52 PM
 */

#include <xc.h> // include processor files - each processor file is guarded.  
#include <stdint.h> // include standard integer data types
#include <stdbool.h> // include standard boolean data types

#include "main.h" // include main header

// Task managing variables
volatile bool run_main = true; // Flag allowing to terminate the main loop and restart the CPU

#define  TMR1_TIMEOUT 30000   // Timeout protection for Timer1 interrupt flag bit
volatile bool LOW_PRIORITY_GO = false;  // Flag allowing low priority tasks to be executed

/* PRIVATE FUNCTION CALL PROTOTYPES */
volatile uint16_t sysLowPriorityTasks_Execute(void);
volatile uint16_t __attribute__((always_inline)) sysHighPriorityTasks_Execute(void);
  

/*******************************************************************************
 * @fn     int main(void)
 * @ingroup firmware-flow
 * @brief  Application main function executed after device comes out of RESET
 * @return Signed Integer (0=failure, 1=success)
 * @details
 * This function is the starting point of the firmware. It is called after the
 * device is coming out of RESET, starting to execute code. The startup sequence 
 * is as follows:
 * 
 * 1) SYSTEM_Initialize:
 * 
 * a) Configures the fundamental system components such as 
 * 
 * Fundamental components are peripherals which are essential for the CPU to run,
 * such as
 * 
 * - system oscillator
 * - auxiliary oscillator
 * - general purpose input/output configuration
 *      
 * b) User-defined Peripheral Module Configurations
 * 
 * This hardware requires some specific peripheral modules to support circuit 
 * functions, such as
 * 
 * - Digital-To-Analog Converter (DAC):
 * This peripheral instance is used to provide an analog debugging signal which 
 * can be used to output internal high-speed signals/values on an oscilloscope.
 * 
 * - Operational Amplifier (OPA)
 * The analog debugging signal generated by the DAC is buffered by one of the 
 * internal operational amplifiers to stabilize the signal when probed.
 *          
 * 2) Software Modules Initialization
 * 
 * This application executes five tasks simultaneously:
 * 
 * - High Priority Tasks
 *     - Power Supply State Machine & Control 
 *     - System Fault Handler & Diagnostics
 * 
 * - Low Priority Tasks
 *     - LCD Display Control & Update
 *     - On-Board Push-Button HMI Control
 *     - On-Board Debugging LED Control
 * 
 * Each 'Task' is an independent process which is called at a constant execution
 * frequency. The default frequency (OS base clock) set in this code version is 
 * 100 us (= 10 kHz).
 * Tasks may slow down their individual execution rate by using internal counters
 * to be executed as integer multiples of the OS base clock.
 * 
 *********************************************************************************/

int main(void) {

    volatile uint16_t retval = 1;
    volatile uint16_t timeout = 0;
    
    // Initialize basic system configuration
    retval &= SYSTEM_Initialize();
    
    // Initialize special, application-specific peripherals 
    retval &= sysUserPeriperhals_Initialize();

    // Initialize software modules
    retval &= sysUserTasks_Initialize();
    
    // Enable OS Timer
    retval &= sysOsTimer_Enable(true, _OSTIMER_PRIORITY);

    // Last line of defense:
    // when configuration of any block failed...
    if (!retval)
        CPU_RESET();        // reset the CPU and try again


    // Main program execution
    while (run_main) {

        // wait for timer1 to overrun
        while ((!LOW_PRIORITY_GO) && (timeout++ < TMR1_TIMEOUT));
        LOW_PRIORITY_GO = false;
        timeout = 0;    // Reset timeout counter

        // ~~~~~~~~~~~~~~~~~~~~~~~~~~~~~~~~~~~~~~~~~~~~~~~~~~~~~~~~~~~~~~~~~
        // Execute non-time critical, low-priority tasks
            
        retval &= sysLowPriorityTasks_Execute();
        
        // ~~~~~~~~~~~~~~~~~~~~~~~~~~~~~~~~~~~~~~~~~~~~~~~~~~~~~~~~~~~~~~~~~

    }

    CPU_RESET();    // if the firmware ever ends up here, reset the CPU

    return (0);
}

/**********************************************************************************
 * @fn      uint16_t sysLowPriorityTasks_Execute(void)
 * @ingroup main-loop-low-priority
 * @brief   Low priority task sequence executed after the high priority task sequence execution is complete
 * @return  unsigned integer (0=failure, 1=success)
 * 
 * @details
 * This application executes different tasks of which some are time 
 * critical while others are insensitive to execution time jitter. 
 * This function is calling all non-time critical tasks. it is called
 * after all high-priority tasks have been executed. 
 * 
 * @note
 *  (this application does not execute low priority tasks)
 * 
 * ********************************************************************************/

volatile uint16_t sysLowPriorityTasks_Execute(void)
{
    volatile uint16_t retval=1;
    
    // Execute non-time critical, low-priority tasks
    retval &= appLCD_Execute();
    retval &= appLED_Execute();
    retval &= appPushButton_Execute();
    
    return(retval);
}

/**********************************************************************************
 * @fn      uint16_t sysHighPriorityTasks_Execute(void)
 * @ingroup main-loop-high-priority
 * @brief   High priority task sequence executed at a fixed repetition frequency
 * @return  unsigned integer (0=failure, 1=success)
 * 
 * @details
 * This application executes different tasks of which some are time 
 * critical while others are insensitive against execution period or
 * execution repetition frequency jitter. 
 * 
 * The following function calls a sequence of time critical tasks. This
 * function is called by an interrupt service routine at a higher priority
 * than the main loop, enforcing a more time stringent execution repetition 
 * frequency.
 * 
 * ********************************************************************************/

volatile uint16_t sysHighPriorityTasks_Execute(void)
{
    volatile uint16_t retval=1;
    
    // Execute high priority, time critical tasks
    retval &= appPowerSupply_Execute();   // Execute power supply state machine
    retval &= appFaultMonitor_Execute();  // Execute fault handler
    
    return(retval);
}


/**********************************************************************************
 * @fn     void _OsTimerInterrupt(void)
 * @brief  High priority task sequence executed on a fixed 100us pace
 * 
 * @details
 * This interrupt is used to call the high priority task sequence at a fixed
 * repetition frequency of 10 kHz (= 100 us period). 
 * 
 * ********************************************************************************/

void __attribute__((__interrupt__, context, no_auto_psv)) _OsTimerInterrupt(void)
{
	volatile uint16_t retval=1;
	
    #if (DBGPIN1_ENABLE)
    DBGPIN1_Set();              // Set the CPU debugging pin HIGH
    #endif

    retval &= sysHighPriorityTasks_Execute(); // Execute list of high priority tasks
    
    LOW_PRIORITY_GO = true; // Set GO trigger for low priority tasks
    _OSTIMER_IF = 0; // Reset the interrupt flag bit

    #if (DBGPIN1_ENABLE)
    DBGPIN1_Clear();            // Clear the CPU debugging pin
    #endif
    
    return;
}

// ______________________________________
// end of file



